## Documentation/devicetree/bindings/arm/novatek.yaml
```yaml
# SPDX-License-Identifier: (GPL-2.0-only OR BSD-2-Clause)
%YAML 1.2
---
$id: http://devicetree.org/schemas/arm/novatek.yaml#
$schema: http://devicetree.org/meta-schemas/core.yaml#

title: Novatek NA51089 SoC

maintainers:
  - Yu-Tung Chang <mtwget@gmail.com>

description:
  The Novatek NA51089 SoC combines an ARM Cortex-A9 processor with integrated
  peripheral controllers.

properties:
  $nodename:
    const: '/'

  compatible:
    contains:
      const: novatek,na51089

  cpus:
    type: object
    additionalProperties: true

    patternProperties:
      '^cpu@[0-9a-f]+$':
        type: object
        additionalProperties: true

        properties:
          clocks:
            items:
              - description: CPU clock mux output
              - description: Programmable PLL8 CPU clock source
              - description: Fixed 480 MHz CPU clock source

          clock-names:
            items:
              - const: cpu
              - const: pll8
              - const: fixed480

        dependentRequired:
          clocks: [clock-names]
          clock-names: [clocks]

required:
  - compatible

additionalProperties: true
```

## Documentation/devicetree/bindings/clock/novatek,na51089-cgu.yaml
```yaml
# SPDX-License-Identifier: (GPL-2.0-only OR BSD-2-Clause)
%YAML 1.2
---
$id: http://devicetree.org/schemas/clock/novatek,na51089-cgu.yaml#
$schema: http://devicetree.org/meta-schemas/core.yaml#

title: Novatek NA51089 Clock and Reset Controller

maintainers:
  - Yudong Zhang <mtwget@gmail.com>

description: |
  The clock generation unit provides clocks and reset signals for the CPU and
  peripheral blocks of the Novatek NA51089 SoC.

properties:
  compatible:
    const: novatek,na51089-cgu

  reg:
    maxItems: 1

  clocks:
    description: 12 MHz oscillator input
    maxItems: 1

  clock-names:
    const: osc

  '#clock-cells':
    description: |
      The clock ID is defined in
      include/dt-bindings/clock/novatek,na51089-clock.h.
    const: 1

  '#reset-cells':
    description: |
      The reset ID is defined in
      include/dt-bindings/reset/novatek,na51089-reset.h.
    const: 1

required:
  - compatible
  - reg
  - clocks
  - clock-names
  - '#clock-cells'
  - '#reset-cells'

additionalProperties: false

examples:
  - |
    clock-controller@f0020000 {
        compatible = "novatek,na51089-cgu";
        reg = <0xf0020000 0x5000>;
        clocks = <&osc>;
        clock-names = "osc";
        #clock-cells = <1>;
        #reset-cells = <1>;
    };
```

## Documentation/devicetree/bindings/counter/novatek,na51089-ccnt.yaml
```yaml
# SPDX-License-Identifier: (GPL-2.0-only OR BSD-2-Clause)
%YAML 1.2
---
$id: http://devicetree.org/schemas/counter/novatek,na51089-ccnt.yaml#
$schema: http://devicetree.org/meta-schemas/core.yaml#

title: Novatek NA51089 input cycle counters

maintainers:
  - Yu-Tung Chang <mtwget@gmail.com>

properties:
  compatible:
    const: novatek,na51089-ccnt

required:
  - compatible

additionalProperties: false
```

## Documentation/devicetree/bindings/crypto/novatek,na51089-crypto.yaml
```yaml
# SPDX-License-Identifier: (GPL-2.0-only OR BSD-2-Clause)
%YAML 1.2
---
$id: http://devicetree.org/schemas/crypto/novatek,na51089-crypto.yaml#
$schema: http://devicetree.org/meta-schemas/core.yaml#

title: Novatek NA51089 symmetric cryptographic accelerator

maintainers:
  - Yu-Tung Chang <mtwget@gmail.com>

properties:
  compatible:
    const: novatek,na51089-crypto

  reg:
    maxItems: 1

  interrupts:
    maxItems: 1

  clocks:
    maxItems: 1

  resets:
    maxItems: 1

  novatek,no-dma:
    type: boolean
    description: Disable internal DMA and use PIO only.

required:
  - compatible
  - reg
  - interrupts
  - clocks
  - resets

additionalProperties: false

examples:
  - |
    #include <dt-bindings/clock/novatek,na51089-clock.h>
    #include <dt-bindings/interrupt-controller/arm-gic.h>
    #include <dt-bindings/reset/novatek,na51089-reset.h>

    crypto@f0620000 {
        compatible = "novatek,na51089-crypto";
        reg = <0xf0620000 0x100>;
        interrupts = <GIC_SPI 38 IRQ_TYPE_LEVEL_HIGH>;
        clocks = <&cgu NA51089_CLK_CRYPTO>;
        resets = <&cgu NA51089_RESET_CRYPTO>;
    };
```

## Documentation/devicetree/bindings/crypto/novatek,na51089-hash.yaml
```yaml
# SPDX-License-Identifier: (GPL-2.0-only OR BSD-2-Clause)
%YAML 1.2
---
$id: http://devicetree.org/schemas/crypto/novatek,na51089-hash.yaml#
$schema: http://devicetree.org/meta-schemas/core.yaml#

title: Novatek NA51089 hash accelerator

maintainers:
  - Yu-Tung Chang <mtwget@gmail.com>

properties:
  compatible:
    const: novatek,na51089-hash

  reg:
    maxItems: 1

  interrupts:
    maxItems: 1

  clocks:
    maxItems: 1

  resets:
    maxItems: 1

  novatek,no-dma:
    type: boolean
    description: Disable internal DMA and use PIO only.

required:
  - compatible
  - reg
  - interrupts
  - clocks
  - resets

additionalProperties: false

examples:
  - |
    #include <dt-bindings/clock/novatek,na51089-clock.h>
    #include <dt-bindings/interrupt-controller/arm-gic.h>
    #include <dt-bindings/reset/novatek,na51089-reset.h>

    crypto@f0670000 {
        compatible = "novatek,na51089-hash";
        reg = <0xf0670000 0x100>;
        interrupts = <GIC_SPI 28 IRQ_TYPE_LEVEL_HIGH>;
        clocks = <&cgu NA51089_CLK_HASH>;
        resets = <&cgu NA51089_RESET_HASH>;
    };
```

## Documentation/devicetree/bindings/crypto/novatek,na51089-rsa.yaml
```yaml
# SPDX-License-Identifier: (GPL-2.0-only OR BSD-2-Clause)
%YAML 1.2
---
$id: http://devicetree.org/schemas/crypto/novatek,na51089-rsa.yaml#
$schema: http://devicetree.org/meta-schemas/core.yaml#

title: Novatek NA51089 RSA accelerator

maintainers:
  - Yu-Tung Chang <mtwget@gmail.com>

properties:
  compatible:
    const: novatek,na51089-rsa

  reg:
    maxItems: 1

  interrupts:
    maxItems: 1

  clocks:
    maxItems: 1

  resets:
    maxItems: 1

  power-domains:
    maxItems: 1

required:
  - compatible
  - reg
  - interrupts
  - clocks
  - resets
  - power-domains

additionalProperties: false

examples:
  - |
    #include <dt-bindings/clock/novatek,na51089-clock.h>
    #include <dt-bindings/interrupt-controller/arm-gic.h>
    #include <dt-bindings/power/novatek,na51089-sramctrl.h>
    #include <dt-bindings/reset/novatek,na51089-reset.h>

    crypto@f06a0000 {
        compatible = "novatek,na51089-rsa";
        reg = <0xf06a0000 0x100>;
        interrupts = <GIC_SPI 20 IRQ_TYPE_LEVEL_HIGH>;
        clocks = <&cgu NA51089_CLK_RSA>;
        resets = <&cgu NA51089_RESET_RSA>;
        power-domains = <&sramctrl NA51089_SRAM_SW_RSA>;
    };
```

## Documentation/devicetree/bindings/gpio/novatek,na51089-gpio.yaml
```yaml
# SPDX-License-Identifier: (GPL-2.0-only OR BSD-2-Clause)
%YAML 1.2
---
$id: http://devicetree.org/schemas/gpio/novatek,na51089-gpio.yaml#
$schema: http://devicetree.org/meta-schemas/core.yaml#

title: Novatek NA51089 GPIO controller

maintainers:
  - Yudong Zhang <mtwget@gmail.com>

properties:
  compatible:
    const: novatek,na51089-gpio

  reg:
    maxItems: 1

  interrupts:
    maxItems: 1

  gpio-controller: true

  "#gpio-cells":
    const: 2

  gpio-ranges:
    minItems: 8
    maxItems: 8

  interrupt-controller: true

  "#address-cells":
    const: 0

  "#interrupt-cells":
    const: 2

required:
  - compatible
  - reg
  - interrupts
  - gpio-controller
  - "#gpio-cells"
  - gpio-ranges
  - interrupt-controller
  - "#address-cells"
  - "#interrupt-cells"

additionalProperties: false

examples:
  - |
    #include <dt-bindings/gpio/novatek,na51089-gpio.h>
    #include <dt-bindings/interrupt-controller/arm-gic.h>
    #include <dt-bindings/interrupt-controller/irq.h>

    / {
      #address-cells = <1>;
      #size-cells = <1>;
      interrupt-parent = <&gic>;

      gic: interrupt-controller@ffd01000 {
        compatible = "arm,cortex-a9-gic";
        reg = <0xffd01000 0x1000>,
              <0xffd00100 0x100>;
        interrupt-controller;
        #address-cells = <0>;
        #interrupt-cells = <3>;
      };

      pinctrl: pinctrl@f0010000 {
        compatible = "novatek,na51089-pinctrl";
        reg = <0xf0010000 0x2000>,
              <0xf0030000 0x2000>;
        reg-names = "top", "pad";
      };

      gpio: gpio@f0070000 {
        compatible = "novatek,na51089-gpio";
        reg = <0xf0070000 0x100>;
        interrupts = <GIC_SPI 24 IRQ_TYPE_LEVEL_HIGH>;
        gpio-controller;
        #gpio-cells = <2>;
        gpio-ranges = <&pinctrl NA51089_CGPIO(0) NA51089_CGPIO(0) 23>,
                      <&pinctrl NA51089_PGPIO(0) NA51089_PGPIO(0) 26>,
                      <&pinctrl NA51089_SGPIO(0) NA51089_SGPIO(0) 9>,
                      <&pinctrl NA51089_LGPIO(0) NA51089_LGPIO(0) 10>,
                      <&pinctrl NA51089_DGPIO(0) NA51089_DGPIO(0) 8>,
                      <&pinctrl NA51089_HGPIO(0) NA51089_HGPIO(0) 12>,
                      <&pinctrl NA51089_AGPIO(0) NA51089_AGPIO(0) 3>,
                      <&pinctrl NA51089_DSIGPIO(0) NA51089_DSIGPIO(0) 11>;
        interrupt-controller;
        #address-cells = <0>;
        #interrupt-cells = <2>;
      };
    };

...
```

## Documentation/devicetree/bindings/i2c/novatek,na51089-i2c.yaml
```yaml
# SPDX-License-Identifier: (GPL-2.0-only OR BSD-2-Clause)
%YAML 1.2
---
$id: http://devicetree.org/schemas/i2c/novatek,na51089-i2c.yaml#
$schema: http://devicetree.org/meta-schemas/core.yaml#

title: Novatek NA51089 I2C controller

maintainers:
  - Yu-Tung Chang <mtwget@gmail.com>

allOf:
  - $ref: /schemas/i2c/i2c-controller.yaml#

properties:
  compatible:
    const: novatek,na51089-i2c

  reg:
    maxItems: 1

  clocks:
    maxItems: 1

  interrupts:
    maxItems: 1

  resets:
    maxItems: 1

  clock-frequency:
    maximum: 1000000
    default: 100000

  novatek,no-dma:
    description: Disable internal DMA and use PIO only.
    type: boolean

required:
  - compatible
  - reg
  - clocks
  - interrupts
  - resets

unevaluatedProperties: false

examples:
  - |
    #include <dt-bindings/clock/novatek,na51089-clock.h>
    #include <dt-bindings/interrupt-controller/arm-gic.h>
    #include <dt-bindings/reset/novatek,na51089-reset.h>

    i2c@f0220000 {
        compatible = "novatek,na51089-i2c";
        reg = <0xf0220000 0x40>;
        clocks = <&cgu NA51089_CLK_I2C0>;
        interrupts = <GIC_SPI 41 IRQ_TYPE_LEVEL_HIGH>;
        resets = <&cgu NA51089_RESET_I2C0>;
        clock-frequency = <100000>;
        #address-cells = <1>;
        #size-cells = <0>;
    };
```

## Documentation/devicetree/bindings/iio/adc/novatek,na51089-adc.yaml
```yaml
# SPDX-License-Identifier: (GPL-2.0-only OR BSD-2-Clause)
%YAML 1.2
---
$id: http://devicetree.org/schemas/iio/adc/novatek,na51089-adc.yaml#
$schema: http://devicetree.org/meta-schemas/core.yaml#

title: Novatek NA51089 ADC and thermal sensor

maintainers:
  - Yu-Tung Chang <mtwget@gmail.com>

properties:
  compatible:
    const: novatek,na51089-adc

  reg:
    maxItems: 1

  clocks:
    maxItems: 1

  interrupts:
    maxItems: 1

  resets:
    maxItems: 1

  "#io-channel-cells":
    description:
      Channels 0 through 2 select voltage inputs. Channel 3 selects the
      internal temperature sensor.
    const: 1

  "#address-cells":
    const: 1

  "#size-cells":
    const: 0

  nvmem-cells:
    items:
      - description: Temperature calibration word containing redundant trim data

  nvmem-cell-names:
    const: thermal-calibration

patternProperties:
  "^channel@[0-2]$":
    $ref: adc.yaml
    type: object
    description:
      A voltage input.

    properties:
      reg:
        items:
          minimum: 0
          maximum: 2

      bipolar: false
      diff-channels: false
      common-mode-channel: false

    required:
      - reg

    unevaluatedProperties: false

dependencies:
  nvmem-cells: [ nvmem-cell-names ]
  nvmem-cell-names: [ nvmem-cells ]

required:
  - compatible
  - reg
  - clocks
  - interrupts
  - resets
  - "#io-channel-cells"

additionalProperties: false

examples:
  - |
    #include <dt-bindings/clock/novatek,na51089-clock.h>
    #include <dt-bindings/interrupt-controller/arm-gic.h>
    #include <dt-bindings/reset/novatek,na51089-reset.h>

    adc@f0260000 {
        compatible = "novatek,na51089-adc";
        reg = <0xf0260000 0x84>;
        clocks = <&cgu NA51089_CLK_ADC>;
        interrupts = <GIC_SPI 47 IRQ_TYPE_LEVEL_HIGH>;
        resets = <&cgu NA51089_RESET_ADC>;
        nvmem-cells = <&thermal_calibration>;
        nvmem-cell-names = "thermal-calibration";
        #io-channel-cells = <1>;
        #address-cells = <1>;
        #size-cells = <0>;

        channel@0 {
            reg = <0>;
        };
    };
```

## Documentation/devicetree/bindings/media/novatek,na51089-ir.yaml
```yaml
# SPDX-License-Identifier: (GPL-2.0-only OR BSD-2-Clause)
%YAML 1.2
---
$id: http://devicetree.org/schemas/media/novatek,na51089-ir.yaml#
$schema: http://devicetree.org/meta-schemas/core.yaml#

title: Novatek NA51089 infrared receiver

maintainers:
  - Yu-Tung Chang <mtwget@gmail.com>

allOf:
  - $ref: rc.yaml#

properties:
  compatible:
    const: novatek,na51089-ir

  reg:
    maxItems: 1

  clocks:
    maxItems: 1

  interrupts:
    maxItems: 1

  resets:
    maxItems: 1

  wakeup-source: true

required:
  - compatible
  - reg
  - clocks
  - interrupts
  - resets

unevaluatedProperties: false

examples:
  - |
    #include <dt-bindings/clock/novatek,na51089-clock.h>
    #include <dt-bindings/interrupt-controller/arm-gic.h>
    #include <dt-bindings/reset/novatek,na51089-reset.h>

    ir: ir-receiver@f0250000 {
        compatible = "novatek,na51089-ir";
        reg = <0xf0250000 0x2c>;
        clocks = <&cgu NA51089_CLK_REMOTE>;
        interrupts = <GIC_SPI 25 IRQ_TYPE_LEVEL_HIGH>;
        resets = <&cgu NA51089_RESET_REMOTE>;
        pinctrl-names = "default";
        pinctrl-0 = <&remote_pins_a>;
    };
```
