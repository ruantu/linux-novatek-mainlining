## Documentation/devicetree/bindings/pwm/novatek,na51089-pwm.yaml
```yaml
# SPDX-License-Identifier: (GPL-2.0-only OR BSD-2-Clause)
%YAML 1.2
---
$id: http://devicetree.org/schemas/pwm/novatek,na51089-pwm.yaml#
$schema: http://devicetree.org/meta-schemas/core.yaml#

title: Novatek NA51089 PWM outputs

maintainers:
  - Yu-Tung Chang <mtwget@gmail.com>

allOf:
  - $ref: pwm.yaml#

properties:
  compatible:
    const: novatek,na51089-pwm

  "#pwm-cells":
    const: 3

required:
  - compatible
  - "#pwm-cells"

unevaluatedProperties: false
```

## Documentation/devicetree/bindings/rng/novatek,na51089-rng.yaml
```yaml
# SPDX-License-Identifier: (GPL-2.0-only OR BSD-2-Clause)
%YAML 1.2
---
$id: http://devicetree.org/schemas/rng/novatek,na51089-rng.yaml#
$schema: http://devicetree.org/meta-schemas/core.yaml#

title: Novatek NA51089 True Random Number Generator

maintainers:
  - Yu-Tung Chang <mtwget@gmail.com>

properties:
  compatible:
    const: novatek,na51089-rng

  reg:
    maxItems: 1

  clocks:
    items:
      - description: Core clock
      - description: Ring oscillator clock

  clock-names:
    items:
      - const: core
      - const: ro

  resets:
    maxItems: 1

required:
  - compatible
  - reg
  - clocks
  - clock-names
  - resets

additionalProperties: false

examples:
  - |
    #include <dt-bindings/clock/novatek,na51089-clock.h>
    #include <dt-bindings/reset/novatek,na51089-reset.h>

    rng@f0680000 {
        compatible = "novatek,na51089-rng";
        reg = <0xf0680000 0x10>;
        clocks = <&cgu NA51089_CLK_TRNG>, <&cgu NA51089_CLK_TRNG_RO>;
        clock-names = "core", "ro";
        resets = <&cgu NA51089_RESET_TRNG>;
    };
```

## Documentation/devicetree/bindings/rtc/novatek,na51089-drtc.yaml
```yaml
# SPDX-License-Identifier: (GPL-2.0-only OR BSD-2-Clause)
%YAML 1.2
---
$id: http://devicetree.org/schemas/rtc/novatek,na51089-drtc.yaml#
$schema: http://devicetree.org/meta-schemas/core.yaml#

title: Novatek NA51089 Digital Real Time Clock

maintainers:
  - Yu-Tung Chang <mtwget@gmail.com>

allOf:
  - $ref: rtc.yaml#

properties:
  compatible:
    const: novatek,na51089-drtc

  reg:
    maxItems: 1

  interrupts:
    maxItems: 1

  clocks:
    maxItems: 1

  resets:
    maxItems: 1

required:
  - compatible
  - reg
  - interrupts
  - clocks
  - resets

unevaluatedProperties: false

examples:
  - |
    #include <dt-bindings/clock/novatek,na51089-clock.h>
    #include <dt-bindings/interrupt-controller/arm-gic.h>
    #include <dt-bindings/interrupt-controller/irq.h>
    #include <dt-bindings/reset/novatek,na51089-reset.h>

    rtc@f00b0000 {
        compatible = "novatek,na51089-drtc";
        reg = <0xf00b0000 0x100>;
        clocks = <&cgu NA51089_CLK_DRTC>;
        interrupts = <GIC_SPI 4 IRQ_TYPE_LEVEL_HIGH>;
        resets = <&cgu NA51089_RESET_DRTC>;
    };

...
```

## Documentation/devicetree/bindings/serial/novatek,na51089-uart.yaml
```yaml
# SPDX-License-Identifier: (GPL-2.0-only OR BSD-2-Clause)
%YAML 1.2
---
$id: http://devicetree.org/schemas/serial/novatek,na51089-uart.yaml#
$schema: http://devicetree.org/meta-schemas/core.yaml#

title: Novatek NA51089 UART

maintainers:
  - Yu-Tung Chang <mtwget@gmail.com>

allOf:
  - $ref: /schemas/serial/serial.yaml#
  - $ref: /schemas/serial/rs485.yaml#
  - if:
      required:
        - uart-has-rtscts
    then:
      properties:
        linux,rs485-enabled-at-boot-time: false
        rs485-rts-delay: false
        rs485-rts-active-high: false

properties:
  compatible:
    const: novatek,na51089-uart

  reg:
    maxItems: 1

  interrupts:
    maxItems: 1

  clocks:
    maxItems: 1

  resets:
    maxItems: 1

  reg-shift:
    const: 2

  reg-io-width:
    const: 4

  current-speed:
    $ref: /schemas/types.yaml#/definitions/uint32
    minimum: 1
    description: The current active baud rate configured by firmware.

  novatek,no-dma:
    description: Disable internal DMA and use PIO only.
    type: boolean

  rx-tx-swap: false
  cts-rts-swap: false
  tx-threshold: false

  rs485-rts-active-low: false

required:
  - compatible
  - reg
  - interrupts
  - clocks
  - resets
  - reg-shift
  - reg-io-width

unevaluatedProperties: false

examples:
  - |
    #include <dt-bindings/clock/novatek,na51089-clock.h>
    #include <dt-bindings/interrupt-controller/arm-gic.h>
    #include <dt-bindings/interrupt-controller/irq.h>
    #include <dt-bindings/reset/novatek,na51089-reset.h>

    serial@f0300000 {
        compatible = "novatek,na51089-uart";
        reg = <0xf0300000 0x1000>;
        assigned-clocks = <&cgu NA51089_CLK_UART1>;
        assigned-clock-rates = <48000000>;
        clocks = <&cgu NA51089_CLK_UART1>;
        interrupts = <GIC_SPI 44 IRQ_TYPE_LEVEL_HIGH>;
        reg-io-width = <4>;
        reg-shift = <2>;
        resets = <&cgu NA51089_RESET_UART1>;
    };

...
```

## Documentation/devicetree/bindings/soc/novatek/novatek,na51089-sram-controller.yaml
```yaml
# SPDX-License-Identifier: (GPL-2.0-only OR BSD-2-Clause)
%YAML 1.2
---
$id: http://devicetree.org/schemas/soc/novatek/novatek,na51089-sram-controller.yaml#
$schema: http://devicetree.org/meta-schemas/core.yaml#

title: Novatek NA51089 SRAM controller

maintainers:
  - Yudong Zhang <mtwget@gmail.com>

description:
  The SRAM controller provides a shared register controlling the shutdown
  state of the internal SRAMs used by the SoC peripherals.

properties:
  compatible:
    items:
      - const: novatek,na51089-sram-controller
      - const: syscon

  reg:
    maxItems: 1

required:
  - compatible
  - reg

additionalProperties: false

examples:
  - |
    system-controller@f0011000 {
        compatible = "novatek,na51089-sram-controller", "syscon";
        reg = <0xf0011000 0x4>;
    };

...
```

## Documentation/devicetree/bindings/spi/novatek,na51089-fspi.yaml
```yaml
# SPDX-License-Identifier: (GPL-2.0-only OR BSD-2-Clause)
%YAML 1.2
---
$id: http://devicetree.org/schemas/spi/novatek,na51089-fspi.yaml#
$schema: http://devicetree.org/meta-schemas/core.yaml#

title: Novatek NA51089 Flash SPI controller

maintainers:
  - Yu-Tung Chang <mtwget@gmail.com>

allOf:
  - $ref: /schemas/spi/spi-controller.yaml#

properties:
  compatible:
    const: novatek,na51089-fspi

  reg:
    maxItems: 1

  interrupts:
    maxItems: 1

  clocks:
    maxItems: 1

  resets:
    maxItems: 1

  novatek,no-dma:
    type: boolean
    description: Use PIO transfers only.

  spi-slave: false

  power-domains:
    maxItems: 1

required:
  - compatible
  - reg
  - interrupts
  - clocks
  - resets
  - power-domains
  - "#address-cells"
  - "#size-cells"

unevaluatedProperties: false

examples:
  - |
    #include <dt-bindings/clock/novatek,na51089-clock.h>
    #include <dt-bindings/interrupt-controller/arm-gic.h>
    #include <dt-bindings/interrupt-controller/irq.h>
    #include <dt-bindings/power/novatek,na51089-sramctrl.h>
    #include <dt-bindings/reset/novatek,na51089-reset.h>

    fspi: spi@f0400000 {
        compatible = "novatek,na51089-fspi";
        reg = <0xf0400000 0x1000>;
        clocks = <&cgu NA51089_CLK_FSPI>;
        interrupts = <GIC_SPI 29 IRQ_TYPE_LEVEL_HIGH>;
        resets = <&cgu NA51089_RESET_FSPI>;
        power-domains = <&sramctrl NA51089_SRAM_SW_FSPI>;
        #address-cells = <1>;
        #size-cells = <0>;

        flash@0 {
            compatible = "spi-nand";
            reg = <0>;
            spi-max-frequency = <40000000>;
            spi-rx-bus-width = <4>;
            spi-tx-bus-width = <4>;
            nand-ecc-engine = <&fspi>;
            nand-ecc-algo = "rs";
            nand-ecc-strength = <4>;
            nand-ecc-step-size = <512>;
        };
    };

...
```
