## Documentation/devicetree/bindings/mfd/novatek,na51089-pwmss.yaml
```yaml
# SPDX-License-Identifier: (GPL-2.0-only OR BSD-2-Clause)
%YAML 1.2
---
$id: http://devicetree.org/schemas/mfd/novatek,na51089-pwmss.yaml#
$schema: http://devicetree.org/meta-schemas/core.yaml#

title: Novatek NA51089 PWM and counter controller

maintainers:
  - Yu-Tung Chang <mtwget@gmail.com>

properties:
  compatible:
    const: novatek,na51089-pwmss

  reg:
    maxItems: 1

  clocks:
    description:
      The twelve PWM output gate clocks are followed by the three input
      cycle counter gate clocks.
    minItems: 15
    maxItems: 15

  clock-names:
    minItems: 15
    items:
      - const: pwm0
      - const: pwm1
      - const: pwm2
      - const: pwm3
      - const: pwm4
      - const: pwm5
      - const: pwm6
      - const: pwm7
      - const: pwm8
      - const: pwm9
      - const: pwm10
      - const: pwm11
      - const: ccnt0
      - const: ccnt1
      - const: ccnt2

  interrupts:
    maxItems: 1

  resets:
    maxItems: 1

  pwm:
    $ref: /schemas/pwm/novatek,na51089-pwm.yaml#

  counter:
    $ref: /schemas/counter/novatek,na51089-ccnt.yaml#

required:
  - compatible
  - reg
  - clocks
  - clock-names
  - interrupts
  - resets

additionalProperties: false

examples:
  - |
    #include <dt-bindings/clock/novatek,na51089-clock.h>
    #include <dt-bindings/interrupt-controller/arm-gic.h>
    #include <dt-bindings/reset/novatek,na51089-reset.h>

    pwmss@f0210000 {
        compatible = "novatek,na51089-pwmss";
        reg = <0xf0210000 0x400>;
        clocks = <&cgu NA51089_CLK_PWM0>,
                 <&cgu NA51089_CLK_PWM1>,
                 <&cgu NA51089_CLK_PWM2>,
                 <&cgu NA51089_CLK_PWM3>,
                 <&cgu NA51089_CLK_PWM4>,
                 <&cgu NA51089_CLK_PWM5>,
                 <&cgu NA51089_CLK_PWM6>,
                 <&cgu NA51089_CLK_PWM7>,
                 <&cgu NA51089_CLK_PWM8>,
                 <&cgu NA51089_CLK_PWM9>,
                 <&cgu NA51089_CLK_PWM10>,
                 <&cgu NA51089_CLK_PWM11>,
                 <&cgu NA51089_CLK_PICNT0>,
                 <&cgu NA51089_CLK_PICNT1>,
                 <&cgu NA51089_CLK_PICNT2>;
        clock-names = "pwm0", "pwm1", "pwm2", "pwm3",
                      "pwm4", "pwm5", "pwm6", "pwm7",
                      "pwm8", "pwm9", "pwm10", "pwm11",
                      "ccnt0", "ccnt1", "ccnt2";
        interrupts = <GIC_SPI 26 IRQ_TYPE_LEVEL_HIGH>;
        resets = <&cgu NA51089_RESET_PWM>;

        pwm {
            compatible = "novatek,na51089-pwm";
            #pwm-cells = <3>;
        };

        counter {
            compatible = "novatek,na51089-ccnt";
        };
    };
```

## Documentation/devicetree/bindings/mfd/novatek,na51089-rtcsys.yaml
```yaml
# SPDX-License-Identifier: (GPL-2.0-only OR BSD-2-Clause)
%YAML 1.2
---
$id: http://devicetree.org/schemas/mfd/novatek,na51089-rtcsys.yaml#
$schema: http://devicetree.org/meta-schemas/core.yaml#

title: Novatek NA51089 RTC System Controller

maintainers:
  - Yu-Tung Chang <mtwget@gmail.com>

properties:
  compatible:
    const: novatek,na51089-rtcsys

  reg:
    maxItems: 1

  interrupts:
    maxItems: 1

  resets:
    maxItems: 1

  rtc:
    type: object
    $ref: /schemas/rtc/novatek,na51089-rtc.yaml#

  power-controller:
    type: object
    $ref: /schemas/power/reset/novatek,na51089-pwbc.yaml#

required:
  - compatible
  - reg
  - interrupts
  - resets
  - rtc

additionalProperties: false

examples:
  - |
    #include <dt-bindings/interrupt-controller/arm-gic.h>
    #include <dt-bindings/interrupt-controller/irq.h>
    #include <dt-bindings/reset/novatek,na51089-reset.h>

    rtc@f0060000 {
        compatible = "novatek,na51089-rtcsys";
        reg = <0xf0060000 0x100>;
        interrupts = <GIC_SPI 56 IRQ_TYPE_LEVEL_HIGH>;
        resets = <&cgu NA51089_RESET_RTC>;

        rtc {
            compatible = "novatek,na51089-rtc";
            wakeup-source;
        };

        power-controller {
            compatible = "novatek,na51089-pwbc";
            system-power-controller;
        };
    };

...
```

## Documentation/devicetree/bindings/mmc/novatek,na51089-mmc.yaml
```yaml
# SPDX-License-Identifier: (GPL-2.0-only OR BSD-2-Clause)
%YAML 1.2
---
$id: http://devicetree.org/schemas/mmc/novatek,na51089-mmc.yaml#
$schema: http://devicetree.org/meta-schemas/core.yaml#

title: Novatek NA51089 SD/SDIO/eMMC controller

maintainers:
  - Yu-Tung Chang <mtwget@gmail.com>

allOf:
  - $ref: mmc-controller.yaml#
  - if:
      properties:
        reg:
          items:
            - items:
                - const: 0xf0510000
                - true
    then:
      required:
        - power-domains
  - if:
      anyOf:
        - required: [sd-uhs-sdr12]
        - required: [sd-uhs-sdr25]
        - required: [sd-uhs-sdr50]
        - required: [sd-uhs-sdr104]
    then:
      properties:
        no-1-8-v: false
      required:
        - vqmmc-supply
  - if:
      properties:
        reg:
          items:
            - items:
                - const: 0xf0420000
                - true
      anyOf:
        - required: [sd-uhs-sdr12]
        - required: [sd-uhs-sdr25]
        - required: [sd-uhs-sdr50]
        - required: [sd-uhs-sdr104]
    then:
      properties:
        pinctrl-names:
          minItems: 3
      required:
        - pinctrl-names
        - pinctrl-1
        - pinctrl-2

properties:
  compatible:
    const: novatek,na51089-mmc

  reg:
    maxItems: 1

  interrupts:
    maxItems: 1

  clocks:
    maxItems: 1

  resets:
    maxItems: 1

  pinctrl-names:
    description:
      MMC0 requires both voltage states to configure its PAD supply.
    oneOf:
      - items:
          - const: default
      - items:
          - const: default
          - const: sdmmc-3v3
          - const: sdmmc-1v8

  novatek,no-dma:
    type: boolean
    description: Disable internal DMA and use PIO only.

  power-domains:
    maxItems: 1
    description:
      Internal SRAM power domain of the third host controller.

required:
  - compatible
  - reg
  - interrupts
  - clocks
  - resets

unevaluatedProperties: false

examples:
  - |
    #include <dt-bindings/clock/novatek,na51089-clock.h>
    #include <dt-bindings/gpio/gpio.h>
    #include <dt-bindings/gpio/novatek,na51089-gpio.h>
    #include <dt-bindings/interrupt-controller/arm-gic.h>
    #include <dt-bindings/interrupt-controller/irq.h>
    #include <dt-bindings/reset/novatek,na51089-reset.h>

    mmc@f0420000 {
        compatible = "novatek,na51089-mmc";
        reg = <0xf0420000 0x1000>;
        clocks = <&cgu NA51089_CLK_SDIO0>;
        interrupts = <GIC_SPI 30 IRQ_TYPE_LEVEL_HIGH>;
        resets = <&cgu NA51089_RESET_SDIO0>;
        pinctrl-names = "default";
        pinctrl-0 = <&sdio0_pins>;
        bus-width = <4>;
        max-frequency = <48000000>;
        cd-gpios = <&gpio NA51089_CGPIO(9) GPIO_ACTIVE_LOW>;
        vmmc-supply = <&reg_tf_3v3>;
        cap-sd-highspeed;
        disable-wp;
        no-1-8-v;
    };

  - |
    #include <dt-bindings/clock/novatek,na51089-clock.h>
    #include <dt-bindings/interrupt-controller/arm-gic.h>
    #include <dt-bindings/interrupt-controller/irq.h>
    #include <dt-bindings/power/novatek,na51089-sramctrl.h>
    #include <dt-bindings/reset/novatek,na51089-reset.h>

    mmc@f0510000 {
        compatible = "novatek,na51089-mmc";
        reg = <0xf0510000 0x1000>;
        clocks = <&cgu NA51089_CLK_SDIO2>;
        interrupts = <GIC_SPI 32 IRQ_TYPE_LEVEL_HIGH>;
        resets = <&cgu NA51089_RESET_SDIO2>;
        power-domains = <&sramctrl NA51089_SRAM_SW_SDIO3>;
        bus-width = <8>;
        max-frequency = <48000000>;
    };

...
```

## Documentation/devicetree/bindings/net/novatek,na51089-dwmac.yaml
```yaml
# SPDX-License-Identifier: (GPL-2.0-only OR BSD-2-Clause)
%YAML 1.2
---
$id: http://devicetree.org/schemas/net/novatek,na51089-dwmac.yaml#
$schema: http://devicetree.org/meta-schemas/core.yaml#

title: Novatek NA51089 Ethernet MAC

maintainers:
  - Yu-Tung Chang <mtwget@gmail.com>

allOf:
  - $ref: snps,dwmac.yaml#
  - if:
      properties:
        phy-mode:
          const: mii
    then:
      properties:
        novatek,rmii-refclk-out: false

properties:
  compatible:
    const: novatek,na51089-dwmac

  reg:
    maxItems: 1
    description:
      MAC core, PHY selection, RMII control and internal PHY registers.

  reg-names:
    const: mac

  interrupts:
    maxItems: 1

  interrupt-names:
    const: macirq

  clocks:
    minItems: 2
    items:
      - description: APB register interface and MDIO divider clock
      - description: Ethernet reference clock
      - description: 25 MHz reference clock output for an external PHY

  clock-names:
    minItems: 2
    items:
      - const: stmmaceth
      - const: ethref
      - const: phy-ref

  resets:
    maxItems: 1

  reset-names:
    const: stmmaceth

  phy-mode:
    enum: [mii, rmii]

  max-speed:
    enum: [10, 100]

  power-domains:
    maxItems: 1

  novatek,rmii-refclk-out:
    type: boolean
    description:
      Drive the 50 MHz RMII reference clock to an external PHY. When absent,
      the MAC uses an external reference clock.

  mdio-mux:
    type: object
    unevaluatedProperties: false
    description:
      Selects between the internal PHY and the external MDIO interface.

    properties:
      compatible:
        const: novatek,na51089-mdio-mux

      mdio-parent-bus:
        $ref: /schemas/types.yaml#/definitions/phandle
        description: Phandle to the MAC MDIO bus.

      resets:
        maxItems: 1
        description: Internal PHY hardware reset.

      reset-names:
        const: phy

      '#address-cells':
        const: 1

      '#size-cells':
        const: 0

      mdio@0:
        $ref: mdio.yaml#
        unevaluatedProperties: false
        description: Internal MDIO bus.

        properties:
          reg:
            const: 0

        patternProperties:
          '^ethernet-phy@[0-9a-f]+$':
            type: object
            $ref: ethernet-phy.yaml#
            unevaluatedProperties: false

            properties:
              resets: false
              reset-names: false

            required:
              - reg

        required:
          - reg
          - '#address-cells'
          - '#size-cells'

      mdio@1:
        $ref: mdio.yaml#
        unevaluatedProperties: false
        description: External MDIO bus.

        properties:
          reg:
            const: 1

        required:
          - reg
          - '#address-cells'
          - '#size-cells'

    required:
      - compatible
      - mdio-parent-bus
      - '#address-cells'
      - '#size-cells'

    dependentRequired:
      resets: [reset-names]
      reset-names: [resets]

    allOf:
      - if:
          required:
            - mdio@0
        then:
          required:
            - resets
            - reset-names

required:
  - compatible
  - reg
  - reg-names
  - interrupts
  - interrupt-names
  - clocks
  - clock-names
  - resets
  - reset-names
  - phy-mode
  - power-domains
  - mdio
  - mdio-mux

unevaluatedProperties: false

examples:
  - |
    #include <dt-bindings/clock/novatek,na51089-clock.h>
    #include <dt-bindings/interrupt-controller/arm-gic.h>
    #include <dt-bindings/power/novatek,na51089-sramctrl.h>
    #include <dt-bindings/reset/novatek,na51089-reset.h>

    ethernet@f02b0000 {
        compatible = "novatek,na51089-dwmac";
        reg = <0xf02b0000 0x3c00>;
        reg-names = "mac";
        interrupts = <GIC_SPI 34 IRQ_TYPE_LEVEL_HIGH>;
        interrupt-names = "macirq";
        clocks = <&cgu NA51089_CLK_APB>, <&cgu NA51089_CLK_ETH>;
        clock-names = "stmmaceth", "ethref";
        resets = <&cgu NA51089_RESET_ETH>;
        reset-names = "stmmaceth";
        power-domains = <&sramctrl NA51089_SRAM_SW_ETH>;
        phy-mode = "mii";
        phy-handle = <&internal_phy>;
        max-speed = <100>;

        mdio0: mdio {
            compatible = "snps,dwmac-mdio";
            #address-cells = <1>;
            #size-cells = <0>;
        };

        mdio-mux {
            compatible = "novatek,na51089-mdio-mux";
            mdio-parent-bus = <&mdio0>;
            resets = <&cgu NA51089_RESET_ETH_PHY>;
            reset-names = "phy";
            #address-cells = <1>;
            #size-cells = <0>;

            mdio@0 {
                reg = <0>;
                #address-cells = <1>;
                #size-cells = <0>;

                internal_phy: ethernet-phy@0 {
                    compatible = "ethernet-phy-ieee802.3-c22";
                    reg = <0>;
                };
            };

            mdio@1 {
                reg = <1>;
                #address-cells = <1>;
                #size-cells = <0>;
            };
        };
    };

  - |
    #include <dt-bindings/clock/novatek,na51089-clock.h>
    #include <dt-bindings/interrupt-controller/arm-gic.h>
    #include <dt-bindings/power/novatek,na51089-sramctrl.h>
    #include <dt-bindings/reset/novatek,na51089-reset.h>

    ethernet@f02b0000 {
        compatible = "novatek,na51089-dwmac";
        reg = <0xf02b0000 0x3c00>;
        reg-names = "mac";
        interrupts = <GIC_SPI 34 IRQ_TYPE_LEVEL_HIGH>;
        interrupt-names = "macirq";
        clocks = <&cgu NA51089_CLK_APB>, <&cgu NA51089_CLK_ETH>,
                 <&cgu NA51089_CLK_ETH_EXT_PHY>;
        clock-names = "stmmaceth", "ethref", "phy-ref";
        resets = <&cgu NA51089_RESET_ETH>;
        reset-names = "stmmaceth";
        power-domains = <&sramctrl NA51089_SRAM_SW_ETH>;
        phy-mode = "rmii";
        phy-handle = <&external_phy>;
        novatek,rmii-refclk-out;
        max-speed = <100>;

        mdio1: mdio {
            compatible = "snps,dwmac-mdio";
            #address-cells = <1>;
            #size-cells = <0>;
        };

        mdio-mux {
            compatible = "novatek,na51089-mdio-mux";
            mdio-parent-bus = <&mdio1>;
            #address-cells = <1>;
            #size-cells = <0>;

            mdio@1 {
                reg = <1>;
                #address-cells = <1>;
                #size-cells = <0>;

                external_phy: ethernet-phy@1 {
                    reg = <1>;
                };
            };
        };
    };
```
