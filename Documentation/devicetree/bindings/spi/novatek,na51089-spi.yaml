## Documentation/devicetree/bindings/spi/novatek,na51089-spi.yaml
```yaml
# SPDX-License-Identifier: (GPL-2.0-only OR BSD-2-Clause)
%YAML 1.2
---
$id: http://devicetree.org/schemas/spi/novatek,na51089-spi.yaml#
$schema: http://devicetree.org/meta-schemas/core.yaml#

title: Novatek NA51089 SPI controller

maintainers:
  - Yu-Tung Chang <mtwget@gmail.com>

allOf:
  - $ref: spi-controller.yaml#

properties:
  compatible:
    const: novatek,na51089-spi

  reg:
    maxItems: 1

  interrupts:
    maxItems: 1

  clocks:
    maxItems: 1

  resets:
    maxItems: 1

  novatek,no-dma:
    type: boolean
    description: Disable internal DMA and use PIO only.

  spi-slave: false

required:
  - compatible
  - reg
  - interrupts
  - clocks
  - resets
  - "#address-cells"
  - "#size-cells"

unevaluatedProperties: false

examples:
  - |
    #include <dt-bindings/clock/novatek,na51089-clock.h>
    #include <dt-bindings/interrupt-controller/arm-gic.h>
    #include <dt-bindings/interrupt-controller/irq.h>
    #include <dt-bindings/reset/novatek,na51089-reset.h>

    spi@f0230000 {
        compatible = "novatek,na51089-spi";
        reg = <0xf0230000 0x10000>;
        clocks = <&cgu NA51089_CLK_SPI0>;
        interrupts = <GIC_SPI 35 IRQ_TYPE_LEVEL_HIGH>;
        resets = <&cgu NA51089_RESET_SPI0>;
        #address-cells = <1>;
        #size-cells = <0>;
    };

...
```

## Documentation/devicetree/bindings/timer/novatek,na51089-timer.yaml
```yaml
# SPDX-License-Identifier: (GPL-2.0-only OR BSD-2-Clause)
%YAML 1.2
---
$id: http://devicetree.org/schemas/timer/novatek,na51089-timer.yaml#
$schema: http://devicetree.org/meta-schemas/core.yaml#

title: Novatek NA51089 timer

maintainers:
  - Yu-Tung Chang <mtwget@gmail.com>

properties:
  compatible:
    const: novatek,na51089-timer

  reg:
    maxItems: 1

  clocks:
    maxItems: 1

  interrupts:
    description: Shared interrupt for all timers
    maxItems: 1

  resets:
    maxItems: 1

required:
  - compatible
  - reg
  - clocks
  - interrupts
  - resets

additionalProperties: false

examples:
  - |
    #include <dt-bindings/clock/novatek,na51089-clock.h>
    #include <dt-bindings/interrupt-controller/arm-gic.h>
    #include <dt-bindings/reset/novatek,na51089-reset.h>

    timer@f0040000 {
        compatible = "novatek,na51089-timer";
        reg = <0xf0040000 0x240>;
        clocks = <&cgu NA51089_CLK_TIMER>;
        interrupts = <GIC_SPI 0 IRQ_TYPE_LEVEL_HIGH>;
        resets = <&cgu NA51089_RESET_TIMER>;
    };

...
```

## Documentation/devicetree/bindings/watchdog/novatek,na51089-wdt.yaml
```yaml
# SPDX-License-Identifier: (GPL-2.0-only OR BSD-2-Clause)
%YAML 1.2
---
$id: http://devicetree.org/schemas/watchdog/novatek,na51089-wdt.yaml#
$schema: http://devicetree.org/meta-schemas/core.yaml#

title: Novatek NA51089 watchdog timer

maintainers:
  - Yu-Tung Chang <mtwget@gmail.com>

allOf:
  - $ref: watchdog.yaml#

properties:
  compatible:
    const: novatek,na51089-wdt

  reg:
    maxItems: 1

  clocks:
    maxItems: 1

  resets:
    maxItems: 1

required:
  - compatible
  - reg
  - clocks
  - resets

unevaluatedProperties: false

examples:
  - |
    #include <dt-bindings/clock/novatek,na51089-clock.h>
    #include <dt-bindings/reset/novatek,na51089-reset.h>

    watchdog@f0050000 {
        compatible = "novatek,na51089-wdt";
        reg = <0xf0050000 0x1000>;
        clocks = <&cgu NA51089_CLK_WDT>;
        resets = <&cgu NA51089_RESET_WDT>;
        timeout-sec = <10>;
    };

...
```

## arch/arm/mach-novatek/Kconfig
```kconfig
# SPDX-License-Identifier: GPL-2.0-only

menuconfig ARCH_NOVATEK
	bool "Novatek SoC support"
	depends on ARCH_MULTI_V7
	help
	  Support for Novatek ARMv7 SoCs.

if ARCH_NOVATEK

config MACH_NA51089
	bool "Novatek NA51089 SoC support"
	default ARCH_NOVATEK
	select ARM_GIC
	select ARM_GLOBAL_TIMER
	select CACHE_L2X0
	select PINCTRL
	select PINCTRL_NOVATEK_NA51089
	select PM
	select PM_GENERIC_DOMAINS
	help
	  Support for Novatek NT9856x (NA51089) SoCs.

endif
```

## drivers/clk/novatek/Kconfig
```kconfig
# SPDX-License-Identifier: GPL-2.0-only

config COMMON_CLK_NOVATEK
	bool

config COMMON_CLK_NOVATEK_NA51089
	bool "Clock driver for Novatek NA51089"
	depends on ARCH_NOVATEK || COMPILE_TEST
	depends on OF && HAS_IOMEM
	select COMMON_CLK_NOVATEK
	select RESET_CONTROLLER
	help
	  Say yes here to enable clock and reset controller support for
	  Novatek NT9856x (NA51089) SoCs.
```

## drivers/pinctrl/novatek/Kconfig
```kconfig
# SPDX-License-Identifier: GPL-2.0-only

config PINCTRL_NOVATEK
	bool
	depends on OF
	select GENERIC_PINCONF
	select PINMUX
```

## drivers/pmdomain/novatek/Kconfig
```kconfig
# SPDX-License-Identifier: GPL-2.0-only

config NOVATEK_SRAMCTRL
	bool "Novatek NT9856x SRAM power domains"
	depends on ARCH_NOVATEK || COMPILE_TEST
	depends on PM && OF
	default y if MACH_NA51089
	select REGMAP_MMIO
	select PM_GENERIC_DOMAINS
	help
	  Enable power domain support for the internal peripheral SRAMs on
	  Novatek NT9856x (NA51089) SoCs.
```
